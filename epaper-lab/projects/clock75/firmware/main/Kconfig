## epaper-lab/projects/clock75/firmware/main/Kconfig
```kconfig
menu "Clock75"

config CLOCK75_MOON_STEP_MIN
    int "Moon elevation step (minutes)"
    range 5 120
    default 30
    help
        Minutes between points in the moon elevation curve.

config CLOCK75_LAT_E6
    int "Latitude (microdegrees)"
    range -90000000 90000000
    default 18520400
    help
        Latitude in microdegrees (e.g., 18.520400 -> 18520400).

config CLOCK75_LON_E6
    int "Longitude (microdegrees)"
    range -180000000 180000000
    default 73856700
    help
        Longitude in microdegrees (e.g., 73.856700 -> 73856700).

endmenu
```

## epaper-lab/projects/clock75/firmware/sdkconfig.defaults
```kconfig
CONFIG_LOG_DEFAULT_LEVEL_INFO=y
CONFIG_ESPTOOLPY_FLASHSIZE_16MB=y
CONFIG_HTTPD_MAX_REQ_HDR_LEN=2048
CONFIG_HTTPD_MAX_URI_LEN=512
```

## epaper-lab/projects/hello75/firmware/main/Kconfig
```kconfig
menu "hello75 pins"

config HELLO75_PIN_MOSI
    int "MOSI GPIO"
    default 11

config HELLO75_PIN_CLK
    int "CLK GPIO"
    default 12

config HELLO75_PIN_CS
    int "CS GPIO"
    default 10

config HELLO75_PIN_DC
    int "DC GPIO"
    default 13

config HELLO75_PIN_RST
    int "RST GPIO"
    default 14

config HELLO75_PIN_BUSY
    int "BUSY GPIO"
    default 21

config HELLO75_SPI_CLOCK_HZ
    int "SPI clock (Hz)"
    default 1000000

config HELLO75_BUSY_IDLE_HIGH
    bool "BUSY idle is HIGH (busy is LOW)"
    default y

config HELLO75_IGNORE_BUSY
    bool "Ignore BUSY pin (use fixed delays)"
    default n

config HELLO75_NO_SLEEP
    bool "Do not send deep sleep after test"
    default n

endmenu
```

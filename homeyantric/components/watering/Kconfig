## homeyantric/components/watering/Kconfig
```kconfig
menu "Watering controller"
    depends on APP_ROLE_WATERING

config WATERING_OUTLETS
    int "Number of plant outlets"
    range 1 4
    default 1
    help
        Use one outlet for a dedicated pump, or three or four for a servo manifold.
endmenu
```

## homeyantric/configs/sdkconfig.defaults.watering
```kconfig
CONFIG_APP_ROLE_BED=n
CONFIG_APP_ROLE_LIGHT=n
CONFIG_APP_ROLE_TRAY=n
CONFIG_APP_ROLE_WATERING=y
CONFIG_WATERING_OUTLETS=1
```

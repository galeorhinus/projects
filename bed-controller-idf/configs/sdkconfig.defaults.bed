## bed-controller-idf/configs/sdkconfig.defaults.bed
```kconfig
CONFIG_APP_ROLE_BED=y
CONFIG_APP_ROLE_LIGHT=n
CONFIG_APP_ROLE_TRAY=n
CONFIG_ESP_SYSTEM_EVENT_TASK_STACK_SIZE=6144
CONFIG_SYSTEM_EVENT_TASK_STACK_SIZE=6144
```

## bed-controller-idf/configs/sdkconfig.defaults.light
```kconfig
CONFIG_APP_ROLE_LIGHT=y
CONFIG_APP_ROLE_BED=n
CONFIG_APP_ROLE_TRAY=n
# Increase system event task stack to avoid sys_evt overflow on S3.
CONFIG_ESP_SYSTEM_EVENT_TASK_STACK_SIZE=6144
```

## bed-controller-idf/configs/sdkconfig.defaults.partitions.esp32_wrover
```kconfig
# Partition table for ESP32 WROVER bed build
CONFIG_PARTITION_TABLE_FILENAME="partitions/bed_esp32_wrover.csv"
CONFIG_PARTITION_TABLE_CUSTOM_FILENAME="partitions/bed_esp32_wrover.csv"
```

## bed-controller-idf/configs/sdkconfig.defaults.partitions.esp32s3
```kconfig
# Partition table for ESP32-S3 bed build
CONFIG_PARTITION_TABLE_FILENAME="partitions/bed_esp32s3.csv"
CONFIG_PARTITION_TABLE_CUSTOM_FILENAME="partitions/bed_esp32s3.csv"
CONFIG_ESPTOOLPY_FLASHSIZE_16MB=y
CONFIG_ESPTOOLPY_FLASHSIZE="16MB"
```

## bed-controller-idf/configs/sdkconfig.defaults.wrover
```kconfig
# ESP32 WROVER / PSRAM defaults
CONFIG_SPIRAM=y
CONFIG_SPIRAM_BOOT_INIT=y
CONFIG_SPIRAM_USE_MALLOC=y
CONFIG_SPIRAM_SPEED_40M=y
CONFIG_SPIRAM_TYPE_AUTO=y
```

## bed-controller-idf/main/Kconfig.projbuild
```kconfig
menu "Application configuration"

config APP_ENABLE_MATTER
    bool "Enable Matter support"
    default n
    help
        Enable building the Matter component. Disable on branches where esp-matter
        is not present to avoid build failures.

config APP_ROLE_BED
    bool "Enable Bed controller role"
    default y

config APP_ROLE_LIGHT
    bool "Enable Light controller role"
    default n

config APP_ROLE_TRAY
    bool "Enable Tray controller role (future)"
    default n

config APP_LABEL_DEVICE_NAME
    string "Default device name (labels)"
    default ""
    help
        Optional device_name label advertised via mDNS and returned by
        /rpc/Peer.Discover. If empty, the hostname is used.

config APP_LABEL_ROOM
    string "Default room name (labels)"
    default "unknown"
    help
        Room label advertised via mDNS and returned by /rpc/Peer.Discover.
        Can be overridden at runtime via /rpc/System.Labels and saved to NVS.

endmenu
```

## bed-controller-idf/sdkconfig.defaults
```kconfig
CONFIG_HTTPD_MAX_REQ_HDR_LEN=2048
CONFIG_PARTITION_TABLE_CUSTOM=y
CONFIG_PARTITION_TABLE_FILENAME="partitions.csv"
CONFIG_PARTITION_TABLE_CUSTOM_FILENAME="partitions.csv"
# CONFIG_PARTITION_TABLE_SINGLE_APP is not set
# CONFIG_PARTITION_TABLE_TWO_OTA is not set
CONFIG_ESPTOOLPY_FLASHSIZE_4MB=y
# CONFIG_ESPTOOLPY_FLASHSIZE_1MB is not set
# CONFIG_ESPTOOLPY_FLASHSIZE_2MB is not set
# CONFIG_ESPTOOLPY_FLASHSIZE_8MB is not set
# CONFIG_ESPTOOLPY_FLASHSIZE_16MB is not set
# CONFIG_ESPTOOLPY_FLASHSIZE_32MB is not set
# CONFIG_ESPTOOLPY_FLASHSIZE_64MB is not set
# CONFIG_ESPTOOLPY_FLASHSIZE_128MB is not set
CONFIG_ESPTOOLPY_FLASHSIZE="4MB"
CONFIG_HTTPD_MAX_URI_LEN=1024
CONFIG_MBEDTLS_HKDF_C=y
# Prefer smaller binary
CONFIG_COMPILER_OPTIMIZATION_SIZE=y
CONFIG_COMPILER_LTO=y
```
